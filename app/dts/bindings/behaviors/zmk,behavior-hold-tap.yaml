## app/dts/bindings/behaviors/zmk,behavior-hold-tap.yaml
```yaml
# Copyright (c) 2020 The ZMK Contributors
# SPDX-License-Identifier: MIT

description: Hold or Tap behavior

compatible: "zmk,behavior-hold-tap"

include: two_param.yaml

properties:
  bindings:
    type: phandles
    required: true
  tapping-term-ms:
    type: int
  tapping_term_ms:
    type: int
    deprecated: true
  quick-tap-ms:
    type: int
    default: -1
  quick_tap_ms:
    type: int
    deprecated: true
  global-quick-tap:
    type: boolean
    deprecated: true
  require-prior-idle-ms:
    type: int
    default: -1
  flavor:
    type: string
    required: false
    default: "hold-preferred"
    enum:
      - "hold-preferred"
      - "balanced"
      - "tap-preferred"
      - "tap-unless-interrupted"
  hold-while-undecided:
    type: boolean
  hold-while-undecided-linger:
    type: boolean
  retro-tap:
    type: boolean
  hold-trigger-key-positions:
    type: array
    required: false
    default: []
  hold-trigger-on-release:
    type: boolean
  same-hand-tap-after-term:
    type: boolean
    description: |
      Gactyl extension. If a hold was decided only because the tapping term expired, and the
      first key pressed afterwards is NOT in hold-trigger-key-positions, release the hold and
      treat the hold-tap as a tap. A trigger-position key keeps the hold.
```

## app/dts/bindings/behaviors/zmk,behavior-hrm-toggle.yaml
```yaml
description: Toggle the runtime (not persisted) global "home-row mods off" flag checked by hold-tap behaviors that set hrm-off-aware

compatible: "zmk,behavior-hrm-toggle"

include: zero_param.yaml
```
